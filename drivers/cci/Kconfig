## drivers/cci/Kconfig
```kconfig
#
# Compalcomm drivers
#
# Copyright (C) 2012 Sony Mobile Communications AB.
#
#

menuconfig CCI_DRIVERS
        tristate "Compalcomm drivers for SA77."
        default y

if CCI_DRIVERS

#[SA77] ==> CCI KLog, added by Jimmy@CCI
source "drivers/cci/klog/Kconfig"
#[SA77] <== CCI KLog, added by Jimmy@CCI

source "drivers/cci/cci_stuff/Kconfig"

#[SA77] S:LE
source "drivers/cci/cci_kernel_info/Kconfig"
#[SA77] E:LE

source "drivers/cci/somc_xssm/Kconfig"

source "drivers/cci/somc_sw/Kconfig"

source "drivers/cci/cci_powermonitor/Kconfig"
endif
```

## drivers/cci/cci_kernel_info/Kconfig
```kconfig
#
# Copyright (C) 2012 Sony Mobile Communications AB.
#
config CCI_KERNEL_INFO
	tristate "CCI kernel info"
	default y
```

## drivers/cci/cci_stuff/Kconfig
```kconfig
#
# Copyright (C) 2012 Sony Mobile Communications AB.
#
config CCI_STUFF
	tristate "CCI stuff"
	default y
```

## drivers/cci/klog/Kconfig
```kconfig
config CCI_KLOG
	bool "CCI kernel and logcat log collector"
	default n

config CCI_KLOG_RECORD_KERNEL_TIMESTAMP
	bool "Record kernel timestmp into KLog header area"
	depends on CCI_KLOG
	default y
	help
	  This option enables KLog to record the kernel timestamp into the KLog header area.

config CCI_KLOG_RECORD_RPM_VERSION
	bool "Record the RPM firmware version into KLog header area"
	depends on CCI_KLOG
	default y
	help
	  This option enables KLog to record the RPM firmware version into the KLog header area.
```

## drivers/cci/somc_sw/Kconfig
```kconfig
#
# Copyright (C) 2012 Sony Mobile Communications AB.
#
config CCI_SOMC_SW_INFO
	tristate "CCI somc sw info"
	default y
```
